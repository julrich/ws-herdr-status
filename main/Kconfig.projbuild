## main/Kconfig.projbuild
```kconfig
menu "Herdr status companion"

    config HERDR_WIFI_SSID
        string "WiFi SSID"
        default ""

    config HERDR_WIFI_PASSWORD
        string "WiFi password"
        default ""

    config HERDR_BRIDGE_HOST
        string "Bridge host or IP"
        default "192.168.2.203"

    config HERDR_BRIDGE_PORT
        int "Bridge HTTP port"
        default 8787

    config HERDR_POLL_PERIOD_MS
        int "Poll period (ms)"
        default 1000

    config HERDR_UI_MAX_AGENTS
        int "Agent rows shown"
        range 1 6
        default 4

endmenu
```
